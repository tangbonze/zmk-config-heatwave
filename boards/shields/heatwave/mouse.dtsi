#define ZMK_POINTING_DEFAULT_MOVE_VAL 1500  // default: 600
#define ZMK_POINTING_DEFAULT_SCRL_VAL 20    // default: 10
#include <dt-bindings/zmk/pointing.h>

&mmv {
  acceleration-exponent = <1>;      // 1
  time-to-max-speed-ms = <150>;    // 40
  delay-ms = <0>;                   // 0
};

&msc {
  acceleration-exponent = <0>;      // 0
  time-to-max-speed-ms = <0>;    // 40
  delay-ms = <0>;                   // 10
};
