## boards/shields/heatwave/Kconfig.defconfig
```kconfig
if SHIELD_HEATWAVE_DONGLE

config ZMK_KEYBOARD_NAME
    default "Keyboard"

config ZMK_SPLIT_ROLE_CENTRAL
    default y

config ZMK_SPLIT
    default y

# Set this to the number of peripherals your dongle will have.
# For a unibody, this would be 1. If you have left and right halves, set it to 2, etc.
config ZMK_SPLIT_BLE_CENTRAL_PERIPHERALS
    default 1

# Set this to ZMK_SPLIT_BLE_CENTRAL_PERIPHERALS + your desired number of BT profiles (minimum is 2 or divide by zero errors)
config BT_MAX_CONN
    default 2

# Set this to the same number as BT_MAX_CONN
config BT_MAX_PAIRED
    default 2

endif

if SHIELD_HEATWAVE_MAIN || SHIELD_HEATWAVE_DONGLE

config ZMK_SPLIT
    default y

endif
```

## boards/shields/heatwave/Kconfig.shield
```kconfig
config SHIELD_HEATWAVE_MAIN
    def_bool $(shields_list_contains,heatwave_main)

config SHIELD_HEATWAVE_DONGLE
    def_bool $(shields_list_contains,heatwave_dongle)
```
